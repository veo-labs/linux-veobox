## Documentation/devicetree/bindings/media/i2c/adv7604.txt
```
* Analog Devices ADV7604/11 video decoder with HDMI receiver

The ADV7604 and ADV7611 are multiformat video decoders with an integrated HDMI
receiver. The ADV7604 has four multiplexed HDMI inputs and one analog input,
and the ADV7611 has one HDMI input and no analog input.

These device tree bindings support the ADV7611 only at the moment.

Required Properties:

  - compatible: Must contain one of the following
    - "adi,adv7611" for the ADV7611

  - reg: I2C slave addresses
    The ADV7604 has thirteen 256-byte maps that can be accessed via the main
    I²C ports. Each map has it own I²C address and acts
    as a standard slave device on the I²C bus.

  - hpd-gpios: References to the GPIOs that control the HDMI hot-plug
    detection pins, one per HDMI input. The active flag indicates the GPIO
    level that enables hot-plug detection.

The device node must contain one 'port' child node per device input and output
port, in accordance with the video interface bindings defined in
Documentation/devicetree/bindings/media/video-interfaces.txt. The port nodes
are numbered as follows.

  Port			ADV7611
------------------------------------------------------------
  HDMI			0
  Digital output	1

The digital output port node must contain at least one endpoint.

Optional Properties:

  - reset-gpios: Reference to the GPIO connected to the device's reset pin.
  - reg-names : Names of maps with programmable addresses.
		It can contain any map needing another address than default one.
		Possible maps names are :
ADV7604 : "main", "avlink", "cec", "infoframe", "esdp", "dpp", "afe", "rep",
		"edid", "hdmi", "test", "cp", "vdp"
ADV7611 : "main", "cec", "infoframe", "afe", "rep", "edid", "hdmi", "cp"

Optional Endpoint Properties:

  The following three properties are defined in video-interfaces.txt and are
  valid for source endpoints only.

  - hsync-active: Horizontal synchronization polarity. Defaults to active low.
  - vsync-active: Vertical synchronization polarity. Defaults to active low.
  - pclk-sample: Pixel clock polarity. Defaults to output on the falling edge.

  If none of hsync-active, vsync-active and pclk-sample is specified the
  endpoint will use embedded BT.656 synchronization.


Example:

	hdmi_receiver@4c {
		compatible = "adi,adv7611";
		/* edid page will be accessible @ 0x66 on i2c bus */
		/* other maps keep their default addresses */
		reg = <0x4c 0x66>;
		reg-names = "main", "edid";

		reset-gpios = <&ioexp 0 GPIO_ACTIVE_LOW>;
		hpd-gpios = <&ioexp 2 GPIO_ACTIVE_HIGH>;

		#address-cells = <1>;
		#size-cells = <0>;

		port@0 {
			reg = <0>;
		};
		port@1 {
			reg = <1>;
			hdmi_in: endpoint {
				remote-endpoint = <&ccdc_in>;
			};
		};
	};
```

## Documentation/devicetree/bindings/media/spi/lmh0395.txt
```
* Texas Instruments lmh0395 3G HD/SD SDI equalizer

"The LMH0395 is an SDI equalizer designed to extend the reach of SDI signals
transmitted over cable by equalizing the input signal and generating clean
outputs. It has one differential input and two differential output that can be
independently controlled."

Required Properties :
- compatible: Must be "ti,lmh0395"

The device node must contain one 'port' child node per device input and output
port, in accordance with the video interface bindings defined in
Documentation/devicetree/bindings/media/video-interfaces.txt.

The LMH0395 has three ports numbered as follows.

  Port			LMH0395
------------------------------------------------------------
  SDI (SDI input)	0
  SDO0 (SDI output 0)	1
  SDO1 (SDI output 1)	2

Example:

ecspi@02010000 {
	...
	...

	lmh0395@1 {
		compatible = "ti,lmh0395";
		reg = <1>;
		spi-max-frequency = <20000000>;
		ports {
			port@0 {
				#address-cells = <1>;
				#size-cells = <0>;
				reg = <0>;
				sdi0_in: endpoint {};
			};
			port@1 {
				reg = <1>;
				sdi0_out0: endpoint {};
			};
			port@2 {
				reg = <2>;
				/* endpoint not specified, disable output */
			};
		};
	};
	...
};
```

## drivers/media/platform/imx/Kconfig
```kconfig
config MEDIA_IMX
	tristate "Multimedia Support for Freescale i.MX"
	depends on MEDIA_CONTROLLER
	---help---
	  This driver provides a SoC wide media controller device that all
	  multimedia components in i.MX5 and i.MX6 SoCs can register with.

config MEDIA_IMX_VIDEO_SWITCH
	tristate "i.MX Video Bus Multiplexer"
	depends on VIDEO_V4L2_SUBDEV_API
	help
	  This driver provides support for SoC internal video bus multiplexers
	  controlled by register bitfields as well as external multiplexers
	  controller by a GPIO.

config VIDEO_IMX_IPU_COMMON
	tristate

config VIDEO_IMX_IPU_CSI
	tristate "i.MX5/6 CMOS Sensor Interface driver"
	depends on VIDEO_DEV && IMX_IPUV3_CORE && MEDIA_CONTROLLER
	select VIDEOBUF2_DMA_CONTIG
	select VIDEO_IMX_IPU_COMMON
	select VIDEO_IMX_IPUV3
	---help---
	  This is a v4l2 video capture driver for the IPUv3 on i.MX5/6.
```

## drivers/media/spi/Kconfig
```kconfig
if VIDEO_V4L2

config VIDEO_LMH0395
	tristate "LMH0395 equalizer"
	depends on VIDEO_V4L2 && SPI && MEDIA_CONTROLLER && OF
	---help---
	  Support for TI LMH0395 3G HD/SD SDI Dual Output Low Power
	  Extended Reach Adaptive Cable Equalizer.

	  To compile this driver as a module, choose M here: the
	  module will be called lmh0395.


endif
```

## drivers/staging/media/imx6/Kconfig
```kconfig
config VIDEO_IMX6
	tristate "i.MX6 V4L2 devices"
	depends on VIDEO_V4L2 && ARCH_MXC && IMX_IPUV3_CORE
	default y
	---help---
	  Say yes here to enable support for video4linux capture for
	  the i.MX6 SOC.

config VIDEO_IMX6_CAMERA
	tristate "i.MX6 Camera Interface driver"
	depends on VIDEO_IMX6 && VIDEO_DEV && I2C
	select VIDEOBUF2_DMA_CONTIG
	default y
	---help---
	  A video4linux capture driver for i.MX6 SOC. Some of the
	  features of this driver include simultaneous streaming
	  and preview (overlay) support, MIPI CSI-2 sensor support,
	  separate rotation control for both streaming and preview,
	  scaling and colorspace conversion, simultaneous capture
	  from separate sensors, dmabuf importer/exporter, and full
	  devicetree support.

if VIDEO_IMX6_CAMERA
source "drivers/staging/media/imx6/capture/Kconfig"
endif
```

## drivers/staging/media/imx6/capture/Kconfig
```kconfig
menu "i.MX6 Camera Sensors"

config IMX6_MIPI_CSI2
       tristate "MIPI CSI2 Receiver Driver"
       depends on VIDEO_IMX6_CAMERA
       default y
       ---help---
         MIPI CSI-2 Receiver driver support. This driver is required
	 for sensor drivers with a MIPI CSI2 interface.

endmenu
```
